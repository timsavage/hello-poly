/*********************************************************************
This is a library for our Monochrome OLEDs based on SSD1306 drivers

  Pick one up today in the adafruit shop!
  ------> http://www.adafruit.com/category/63_98

These displays use SPI to communicate, 4 or 5 pins are required to
interface

Adafruit invests time and resources providing this open source code,
please support Adafruit and open-source hardware by purchasing
products from Adafruit!

Written by Limor Fried/Ladyada  for Adafruit Industries.
BSD license, check license.txt for more information
All text above, and the splash screen below must be included in any redistribution
*********************************************************************/

#include <stdlib.h>
#include <Wire.h>

#include "devices::display::SSD1306.h"

using namespace devices::display;


// the memory buffer for the LCD

static uint8_t buffer[SSD1306_LCDHEIGHT * SSD1306_LCDWIDTH / 8] = {
    0x00, 0x00, 0x00, 0x00, 0x00, 0x00, 0x00, 0x00, 0x00, 0x00, 0x00, 0x00, 0x00, 0x00, 0x00, 0x00,
    0x00, 0x00, 0x00, 0x00, 0x00, 0x00, 0x00, 0x00, 0x00, 0x00, 0x00, 0x00, 0x00, 0x00, 0x00, 0x00,
    0x00, 0x00, 0x00, 0x00, 0x00, 0x00, 0x00, 0x00, 0x00, 0x00, 0x00, 0x00, 0x00, 0x00, 0x00, 0x00,
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    0x00, 0x00, 0x00, 0x00, 0x00, 0x00, 0x00, 0x00, 0x00, 0x00, 0x00, 0x00, 0x00, 0x00, 0x00, 0x00,
#if (SSD1306_HEIGHT == 64)
    0x00, 0x00, 0x00, 0x00, 0x00, 0x00, 0x00, 0x00, 0x00, 0x00, 0x00, 0x00, 0x00, 0x00, 0x00, 0x00,
    0x00, 0x00, 0x00, 0x00, 0x00, 0x00, 0x00, 0x00, 0x00, 0x00, 0x00, 0x00, 0x00, 0x00, 0x00, 0x00,
    0x00, 0x00, 0x00, 0x00, 0x00, 0x00, 0x00, 0x00, 0x00, 0x00, 0x00, 0x00, 0x00, 0x00, 0x00, 0x00,
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    0x00, 0x00, 0x00, 0x00, 0x00, 0x00, 0x00, 0x00, 0x00, 0x00, 0x00, 0x00, 0x00, 0x00, 0x00, 0x00,
#endif
};

#define ssd1306_swap(a, b) { int16_t t = a; a = b; b = t; }

void 
SSD1306::drawPixel(int16_t x, int16_t y, uint16_t color) 
{
    if ((x < 0) || (x >= width()) || (y < 0) || (y >= height()))
    {
        return;
    }

    // check rotation, move pixel around if necessary
    switch (getRotation()) {
    case 1:
        ssd1306_swap(x, y);
        x = WIDTH - x - 1;
        break;
    case 2:
        x = WIDTH - x - 1;
        y = HEIGHT - y - 1;
        break;
    case 3:
        ssd1306_swap(x, y);
        y = HEIGHT - y - 1;
        break;
    }

    // x is which column
    switch (color)
    {
    case WHITE:   buffer[x+ (y/8)*SSD1306_LCDWIDTH] |=  (1 << (y&7)); break;
    case BLACK:   buffer[x+ (y/8)*SSD1306_LCDWIDTH] &= ~(1 << (y&7)); break;
    case INVERSE: buffer[x+ (y/8)*SSD1306_LCDWIDTH] ^=  (1 << (y&7)); break;
    }

}

// initializer for I2C - we only indicate the reset pin!
SSD1306::SSD1306(uint8_t switchvcc, uint8_t i2caddr) : 
    Adafruit_GFX(SSD1306_LCDWIDTH, SSD1306_LCDHEIGHT),
    _i2caddr(i2caddr),
    _vccstate(switchvcc)
{}

void 
SSD1306::sendCommand(uint8_t c) 
{
    Wire.beginTransmission(_i2caddr);
    Wire.write(0x00);
    Wire.write(c);
    Wire.endTransmission();
}

void 
SSD1306::sendCommand(uint8_t c, uint8_t a1)
{
    Wire.beginTransmission(_i2caddr);
    Wire.write(0x00);
    Wire.write(c);
    Wire.write(a1);
    Wire.endTransmission();
}

void 
SSD1306::sendCommand(uint8_t c, uint8_t a1, uint8_t a2)
{
    Wire.beginTransmission(_i2caddr);
    Wire.write(0x00);
    Wire.write(c);
    Wire.write(a1);
    Wire.write(a2);
    Wire.endTransmission();
}

void 
SSD1306::begin() 
{
	// Init sequence
	sendCommand(SSD1306_DISPLAYOFF);
	sendCommand(SSD1306_SETDISPLAYCLOCKDIV, 0x80);  // the suggested ratio 0x80
	sendCommand(SSD1306_SETMULTIPLEX, SSD1306_LCDHEIGHT - 1);

	sendCommand(SSD1306_SETDISPLAYOFFSET, 0x0);  // no offset
	sendCommand(SSD1306_SETSTARTLINE | 0x0);  // line #0
	if (_vccstate == SSD1306_EXTERNALVCC) { 
		sendCommand(SSD1306_CHARGEPUMP, 0x10);
	} else { 
		sendCommand(SSD1306_CHARGEPUMP, 0x14);
	}
	sendCommand(SSD1306_MEMORYMODE, 0x0);
	sendCommand(SSD1306_SEGREMAP | 0x1);
	sendCommand(SSD1306_COMSCANDEC);

#if defined SSD1306_128_32
	sendCommand(SSD1306_SETCOMPINS, 0x02);
	sendCommand(SSD1306_SETCONTRAST, 0x8F);
#elif defined SSD1306_128_64
	sendCommand(SSD1306_SETCOMPINS, 0x12);
	if (_vccstate == SSD1306_EXTERNALVCC) { 
		sendCommand(SSD1306_SETCONTRAST, 0x9F);
	} else { 
		sendCommand(SSD1306_SETCONTRAST, 0xCF);
	}
#endif

	if (_vccstate == SSD1306_EXTERNALVCC) { 
		sendCommand(SSD1306_SETPRECHARGE, 0x22);
	} else { 
		sendCommand(SSD1306_SETPRECHARGE, 0xF1);
	}
	sendCommand(SSD1306_SETVCOMDETECT, 0x40); 
	sendCommand(SSD1306_DISPLAYALLON_RESUME);
	sendCommand(SSD1306_NORMALDISPLAY);
	sendCommand(SSD1306_DEACTIVATE_SCROLL);
	sendCommand(SSD1306_DISPLAYON);
}

void 
SSD1306::display(void) 
{
    sendCommand(SSD1306_COLUMNADDR, 0, SSD1306_LCDWIDTH - 1);
#if SSD1306_LCDHEIGHT == 64
    sendCommand(SSD1306_PAGEADDR, 0, 7);
#elif SSD1306_LCDHEIGHT == 32
    sendCommand(SSD1306_PAGEADDR, 0, 3);
#endif

    // save I2C bitrate
#ifdef TWBR
    uint8_t twbrbackup = TWBR;
    TWBR = 12; // upgrade to 400KHz!
#endif

    for (uint16_t i = 0; i < (SSD1306_LCDWIDTH * SSD1306_LCDHEIGHT / 8); i++) {
        // send a bunch of data in one xmission
        Wire.beginTransmission(_i2caddr);
        Wire.write(0x40);
        for (uint8_t x = 0; x < 16; x++) {
            Wire.write(buffer[i]);
            i++;
        }
        i--;
        Wire.endTransmission();
    }

#ifdef TWBR
    TWBR = twbrbackup;
#endif
}

void 
SSD1306::invertDisplay(uint8_t i) 
{
    if (i) {
        sendCommand(SSD1306_INVERTDISPLAY);
    } else {
        sendCommand(SSD1306_NORMALDISPLAY);
    }
}


// startscrollright
// Activate a right handed scroll for rows start through stop
// Hint, the display is 16 rows tall. To scroll the whole display, run:
// display.scrollright(0x00, 0x0F)
void SSD1306::startscrollright(uint8_t start, uint8_t stop)
{
    sendCommand(SSD1306_RIGHT_HORIZONTAL_SCROLL);
    sendCommand(0X00);
    sendCommand(start);
    sendCommand(0X00);
    sendCommand(stop);
    sendCommand(0X00);
    sendCommand(0XFF);
    sendCommand(SSD1306_ACTIVATE_SCROLL);
}

// startscrollleft
// Activate a right handed scroll for rows start through stop
// Hint, the display is 16 rows tall. To scroll the whole display, run:
// display.scrollright(0x00, 0x0F)
void 
SSD1306::startscrollleft(uint8_t start, uint8_t stop)
{
    sendCommand(SSD1306_LEFT_HORIZONTAL_SCROLL);
    sendCommand(0X00);
    sendCommand(start);
    sendCommand(0X00);
    sendCommand(stop);
    sendCommand(0X00);
    sendCommand(0XFF);
    sendCommand(SSD1306_ACTIVATE_SCROLL);
}

// startscrolldiagright
// Activate a diagonal scroll for rows start through stop
// Hint, the display is 16 rows tall. To scroll the whole display, run:
// display.scrollright(0x00, 0x0F)
void 
SSD1306::startscrolldiagright(uint8_t start, uint8_t stop)
{
    sendCommand(SSD1306_SET_VERTICAL_SCROLL_AREA);
    sendCommand(0X00);
    sendCommand(SSD1306_LCDHEIGHT);
    sendCommand(SSD1306_VERTICAL_AND_RIGHT_HORIZONTAL_SCROLL);
    sendCommand(0X00);
    sendCommand(start);
    sendCommand(0X00);
    sendCommand(stop);
    sendCommand(0X01);
    sendCommand(SSD1306_ACTIVATE_SCROLL);
}

// startscrolldiagleft
// Activate a diagonal scroll for rows start through stop
// Hint, the display is 16 rows tall. To scroll the whole display, run:
// display.scrollright(0x00, 0x0F)
void 
SSD1306::startscrolldiagleft(uint8_t start, uint8_t stop)
{
    sendCommand(SSD1306_SET_VERTICAL_SCROLL_AREA);
    sendCommand(0X00);
    sendCommand(SSD1306_LCDHEIGHT);
    sendCommand(SSD1306_VERTICAL_AND_LEFT_HORIZONTAL_SCROLL);
    sendCommand(0X00);
    sendCommand(start);
    sendCommand(0X00);
    sendCommand(stop);
    sendCommand(0X01);
    sendCommand(SSD1306_ACTIVATE_SCROLL);
}

void 
SSD1306::stopscroll(void)
{
    sendCommand(SSD1306_DEACTIVATE_SCROLL);
}

// Dim the display
// dim = true: display is dimmed
// dim = false: display is normal
// Dim the display
void 
SSD1306::dim(boolean dim) 
{
    // the range of contrast to too small to be really useful
    // it is useful to dim the display
    if (dim) {
        sendCommand(SSD1306_SETCONTRAST, 0);
    } else {
        if (_vccstate == SSD1306_EXTERNALVCC) {
            sendCommand(SSD1306_SETCONTRAST, 0x9F);
        } else {
            sendCommand(SSD1306_SETCONTRAST, 0xCF);
        }
    }
}

// clear everything
void 
SSD1306::clearDisplay(void) 
{
    memset(buffer, 0, (SSD1306_LCDWIDTH * SSD1306_LCDHEIGHT / 8));
}

void 
SSD1306::drawFastHLine(int16_t x, int16_t y, int16_t w, uint16_t color) 
{
    boolean bSwap = false;
    switch(rotation) {
    case 0:
        // 0 degree rotation, do nothing
        break;
    case 1:
        // 90 degree rotation, swap x & y for rotation, then invert x
        bSwap = true;
        ssd1306_swap(x, y);
        x = WIDTH - x - 1;
        break;
    case 2:
        // 180 degree rotation, invert x and y - then shift y around for height.
        x = WIDTH - x - 1;
        y = HEIGHT - y - 1;
        x -= (w-1);
        break;
    case 3:
        // 270 degree rotation, swap x & y for rotation, then invert y  and adjust y for w (not to become h)
        bSwap = true;
        ssd1306_swap(x, y);
        y = HEIGHT - y - 1;
        y -= (w-1);
        break;
    }

    if(bSwap) {
        drawFastVLineInternal(x, y, w, color);
    } else {
        drawFastHLineInternal(x, y, w, color);
    }
}

void SSD1306::drawFastHLineInternal(int16_t x, int16_t y, int16_t w, uint16_t color) 
{
    // Do bounds/limit checks
    if (y < 0 || y >= HEIGHT) { return; }

    // make sure we don't try to draw below 0
    if (x < 0) {
        w += x;
        x = 0;
    }

    // make sure we don't go off the edge of the display
    if ((x + w) > WIDTH) {
        w = (WIDTH - x);
    }

    // if our width is now negative, punt
    if (w <= 0) { return; }

    // set up the pointer for  movement through the buffer
    register uint8_t *pBuf = buffer;
    // adjust the buffer pointer for the current row
    pBuf += ((y/8) * SSD1306_LCDWIDTH);
    // and offset x columns in
    pBuf += x;

    register uint8_t mask = 1 << (y & 7);

    switch (color)
    {
    case WHITE:     while(w--) { *pBuf++ |= mask; }; break;
    case BLACK:     mask = ~mask;   while(w--) { *pBuf++ &= mask; }; break;
    case INVERSE:   while(w--) { *pBuf++ ^= mask; }; break;
    }
}

void 
SSD1306::drawFastVLine(int16_t x, int16_t y, int16_t h, uint16_t color) 
{
    bool bSwap = false;
    switch(rotation) {
    case 0:
        break;
    case 1:
        // 90 degree rotation, swap x & y for rotation, then invert x and adjust x for h (now to become w)
        bSwap = true;
        ssd1306_swap(x, y);
        x = WIDTH - x - 1;
        x -= (h-1);
        break;
    case 2:
        // 180 degree rotation, invert x and y - then shift y around for height.
        x = WIDTH - x - 1;
        y = HEIGHT - y - 1;
        y -= (h-1);
        break;
    case 3:
        // 270 degree rotation, swap x & y for rotation, then invert y
        bSwap = true;
        ssd1306_swap(x, y);
        y = HEIGHT - y - 1;
        break;
    }

    if(bSwap) {
        drawFastHLineInternal(x, y, h, color);
    } else {
        drawFastVLineInternal(x, y, h, color);
    }
}


void 
SSD1306::drawFastVLineInternal(int16_t x, int16_t __y, int16_t __h, uint16_t color) 
{
    // do nothing if we're off the left or right side of the screen
    if (x < 0 || x >= WIDTH) { return; }

    // make sure we don't try to draw below 0
    if (__y < 0) {
        // __y is negative, this will subtract enough from __h to account for __y being 0
        __h += __y;
        __y = 0;
    }

    // make sure we don't go past the height of the display
    if ((__y + __h) > HEIGHT) {
        __h = (HEIGHT - __y);
    }

    // if our height is now negative, punt
    if (__h <= 0) {
        return;
    }

    // this display doesn't need ints for coordinates, use local byte registers for faster juggling
    register uint8_t y = __y;
    register uint8_t h = __h;

    // set up the pointer for fast movement through the buffer
    register uint8_t *pBuf = buffer;
    // adjust the buffer pointer for the current row
    pBuf += ((y / 8) * SSD1306_LCDWIDTH);
    // and offset x columns in
    pBuf += x;

    // do the first partial byte, if necessary - this requires some masking
    register uint8_t mod = (y&7);
    if (mod) {
        // mask off the high n bits we want to set
        mod = 8-mod;

        // note - lookup table results in a nearly 10% performance improvement in fill* functions
        // register uint8_t mask = ~(0xFF >> (mod));
        static uint8_t premask[8] = {0x00, 0x80, 0xC0, 0xE0, 0xF0, 0xF8, 0xFC, 0xFE };
        register uint8_t mask = premask[mod];

        // adjust the mask if we're not going to reach the end of this byte
        if (h < mod) {
            mask &= (0XFF >> (mod-h));
        }

    switch (color)
        {
        case WHITE:   *pBuf |=  mask;  break;
        case BLACK:   *pBuf &= ~mask;  break;
        case INVERSE: *pBuf ^=  mask;  break;
        }

        // fast exit if we're done here!
        if(h<mod) { return; }

        h -= mod;

        pBuf += SSD1306_LCDWIDTH;
    }


    // write solid bytes while we can - effectively doing 8 rows at a time
    if(h >= 8) {
        if (color == INVERSE)  {          // separate copy of the code so we don't impact performance of the black/white write version with an extra comparison per loop
            do  {
                *pBuf=~(*pBuf);

                // adjust the buffer forward 8 rows worth of data
                pBuf += SSD1306_LCDWIDTH;

                // adjust h & y (there's got to be a faster way for me to do this, but this should still help a fair bit for now)
                h -= 8;
            } while(h >= 8);
        } else {
            // store a local value to work with
            register uint8_t val = (color == WHITE) ? 255 : 0;

            do  {
                // write our value in
                *pBuf = val;

                // adjust the buffer forward 8 rows worth of data
                pBuf += SSD1306_LCDWIDTH;

                // adjust h & y (there's got to be a faster way for me to do this, but this should still help a fair bit for now)
                h -= 8;
            } while(h >= 8);
        }
    }

    // now do the final partial byte, if necessary
    if (h) {
        mod = h & 7;
        // this time we want to mask the low bits of the byte, vs the high bits we did above
        // register uint8_t mask = (1 << mod) - 1;
        // note - lookup table results in a nearly 10% performance improvement in fill* functions
        static uint8_t postmask[8] = {0x00, 0x01, 0x03, 0x07, 0x0F, 0x1F, 0x3F, 0x7F };
        register uint8_t mask = postmask[mod];
        switch (color)
        {
        case WHITE:   *pBuf |=  mask;  break;
        case BLACK:   *pBuf &= ~mask;  break;
        case INVERSE: *pBuf ^=  mask;  break;
        }
    }
}
